#include <behaviors.dtsi>
#include <behaviors/num_word.dtsi> // requires auto-layer module
#include <dt-bindings/zmk/keys.h>
#ifdef CONFIG_WIRELESS
    #include <dt-bindings/zmk/bt.h>
    #define _BT_SEL_KEYS_ &bt BT_SEL 0 &bt BT_SEL 1 &bt BT_SEL 2 &bt BT_SEL 3 &bt BT_CLR
#else
    #define _BT_SEL_KEYS_ &trans &trans &trans &trans &trans
#endif

// #define HOST_OS 1
#include "zmk-helpers/helper.h"
#include "zmk-helpers/unicode-chars/greek.dtsi"
// #include "zmk-helpers/unicode-chars/norwegian.dtsi"

#define DEF 0
#define NAV 1
#define FN 2
#define NUM 3
#define SYS 4
#define MOUSE 5
#define GAME 6
#define GAME2 7

#define XXX &none
#define ___ &trans

// norwegian definitions below
#define AE	 SQT	   // Æ
#define OE	 SEMI	   // Ø
#define AA	 LBKT	   // Å
#define NO_PIPE	 GRAVE     // |
#define NO_EXCL  LS(N1)    // !
#define NO_AT 	 RA(N2)    // @
#define NO_HASH	 LS(N3)    // #
#define NO_DLLR	 RA(N4)    // $
#define NO_PRCNT LS(N5)    // %
#define NO_AMPS	 LS(N6)	   // &
#define NO_STAR	 LS(BSLH)  // *
#define NO_LPAR	 LS(N8)    // (
#define NO_RPAR	 LS(N9)    // )
#define NO_LBKT  RA(N8)    // [
#define NO_RBKT  RA(N9)    // ]
#define NO_LBRC	 RA(N7)	   // {
#define NO_RBRC	 RA(N0)	   // }
#define NO_PLUS	 MINUS     // +
#define NO_DASH	 FSLH      // -
#define NO_APOS	 BSLH      // '
#define NO_EQL	 LS(N0)    // =
#define NO_QMARK LS(NO_PLUS) // ?
#define NO_QUOT	 LS(N2)    // "
#define NO_COL	 LS(DOT) // :
#define NO_SCOL  LS(COMMA)   // ;
#define NO_TILDE RA(RBKT)  // ~
#define NO_HAT   LS(RBKT)  // ^
#define NO_LESS  NON_US_BACKSLASH // <
#define NO_MORE  LS(NON_US_BACKSLASH) // >
#define NO_FSLH LS(N7) // /
#define NO_BSLH	 EQUAL // /\
#define NO_OLSH	 RA(NON_US_BACKSLASH) // \


/* Global settings */

#define QUICK_TAP_MS 175

&sk {  // sticky-key config
    release-after-ms = <900>;  // release after 0.9s
    quick-release;             // no double capitalization when rolling keys
};

&sl {  // sticky-layer config
    ignore-modifiers;          // allow chording sticky mods & layers
};

&lt {  // layer-tap config
    flavor = "balanced";
    tapping-term-ms = <200>;
    quick-tap-ms = <QUICK_TAP_MS>;
};

&leader {  // leader-key config
    timeout-ms = <650>;
};

/* Homerow mods */

#define KEYS_L LT0 LT1 LT2 LT3 LT4 LM0 LM1 LM2 LM3 LM4 LB0 LB1 LB2 LB3 LB4  // left hand
#define KEYS_R RT0 RT1 RT2 RT3 RT4 RM0 RM1 RM2 RM3 RM4 RB0 RB1 RB2 RB3 RB4  // right hand
#ifndef LH2
    #define THUMBS LH1 LH0 RH0 RH1                                          // thumbs on 34 keys
#else
    #define THUMBS LH2 LH1 LH0 RH0 RH1 RH2                                  // thumbs on 36+ keys
#endif

#define MAKE_HRM(NAME, HOLD, TAP, TRIGGER_POS) \
    ZMK_HOLD_TAP(NAME, \
        flavor = "balanced"; \
        tapping-term-ms = <280>; \
        quick-tap-ms = <QUICK_TAP_MS>; \
        require-prior-idle-ms = <150>; \
        bindings = <HOLD>, <TAP>; \
        hold-trigger-key-positions = <TRIGGER_POS>; \
        hold-trigger-on-release; \
    )
MAKE_HRM(hml, &kp, &kp, KEYS_R THUMBS)  // left-hand HRMs
MAKE_HRM(hmr, &kp, &kp, KEYS_L THUMBS)  // right-hand HRMs

// HRM combo hack - workaround for lack of tap-only combos (ZMK issue #544)
#define ZMK_COMBO_8(NAME, TAP, KEYPOS, LAYERS, COMBO_TERM, COMBO_IDLE, HOLD, SIDE) \
    MAKE_HRM(hm_combo_ ## NAME, &kp, TAP, SIDE THUMBS) \
    ZMK_COMBO_6(NAME, &hm_combo_ ## NAME HOLD 0, KEYPOS, LAYERS, COMBO_TERM, COMBO_IDLE)

/* Combos, leader key sequences, mouse emulation */

#include "combos.dtsi"  // must be sources after HRM-combo hack
#include "leader.dtsi"
#include "mouse.dtsi"
#include "extra_keys.h"

/* Nav cluster */

// long-tap action on hold, short-tap action on all interrupts
#define MT_CORE \
    flavor = "tap-preferred"; \
    tapping-term-ms = <220>; \
    quick-tap-ms = <220>; \
    hold-trigger-key-positions = <0>;

&mt { MT_CORE };
ZMK_HOLD_TAP(mt_home, bindings = <&masked_home>, <&kp>; MT_CORE)
ZMK_HOLD_TAP(mt_end, bindings = <&masked_end>, <&kp>; MT_CORE)

#define NAV_LEFT  &mt_home 0   LEFT    // tap: left  | long-tap: beginning of line
#define NAV_RIGHT &mt_end 0    RIGHT   // tap: right | long-tap: end       of line
#define NAV_UP    &mt LC(HOME) UP      // tap: up    | long-tap: beginning of document
#define NAV_DOWN  &mt LC(END)  DOWN    // tap: down  | long-tap: end       of document
#define NAV_BSPC  &mt LC(BSPC) BSPC    // tap: bspc  | long-tap: delete word backward
#define NAV_DEL   &mt LC(DEL)  DEL     // tap: del   | long-tap: delete word forward

// mask CTRL when holding left/right to avoid accidental jumps to beginning/end of document
#define MASK_MODS(NAME, MODS, BINDING) \
    ZMK_MOD_MORPH(NAME, \
        bindings = <BINDING>, <BINDING>; \
        mods = <MODS>; \
    )
MASK_MODS(masked_home, (MOD_LCTL), &kp HOME)
MASK_MODS(masked_end,  (MOD_LCTL), &kp END)

/* Caps-word, num-word and smart-mouse */

// tap: sticky-shift | shift + tap/ double-tap: caps-word | hold: shift
ZMK_MOD_MORPH(smart_shft,
    bindings = <&sk LSHFT>, <&caps_word>;
    mods = <(MOD_LSFT)>;
)
&caps_word {  // mods deactivate caps-word, requires PR #1451
    /delete-property/ ignore-modifiers;
};

// tap: num-word | double-tap: sticky num-layer | hold: num-layer
#define SMART_NUM &smart_num NUM 0
ZMK_HOLD_TAP(smart_num,
    flavor = "balanced";
    tapping-term-ms = <200>;
    quick-tap-ms = <QUICK_TAP_MS>;
    bindings = <&mo>, <&num_dance>;
)
ZMK_TAP_DANCE(num_dance,
    tapping-term-ms = <200>;
    bindings = <&num_word NUM>, <&sl NUM>;  // reverse this for sticky-num on single tap
)

// smart-mouse, requires PR #1366
ZMK_TRI_STATE(smart_mouse,
    bindings = <&tog MOUSE>, <&none>, <&tog MOUSE>;
    ignored-key-positions = <LT1 LT3 RT0 RT1 RT2 RT3 RT4 RM1 RM2 RM3 RB1 RB2 RB3 RH0 RH1>;
    ignored-layers = <MOUSE>;
)

/* Custom behaviors */

// Alt+Tab swapper, requires PR #1366
ZMK_TRI_STATE(swapper,
    bindings = <&kt LALT>, <&kp TAB>, <&kt LALT>;
    ignored-key-positions = <LT2>;
)

// reuse basic mod-morph scheme
#define SIMPLE_MORPH(NAME, MOD, BINDING1, BINDING2) \
    ZMK_MOD_MORPH(NAME, \
        mods = <(MOD_L ## MOD|MOD_R ## MOD)>; \
        bindings = <BINDING1>, <BINDING2>; \
    )

// tap: comma | shift + tap: semicolon | ctrl + shift + tap: <
SIMPLE_MORPH(comma_morph, SFT, &kp COMMA, &comma_inner_morph)
SIMPLE_MORPH(comma_inner_morph, CTL, &kp NO_SCOL, &kp NO_LESS)

// tap: dot | shift + tap: colon | ctrl + shift + tap: >
SIMPLE_MORPH(dot_morph, SFT, &kp DOT, &dot_inner_morph)
SIMPLE_MORPH(dot_inner_morph, CTL, &kp NO_COL, &kp NO_MORE)

// tap: qmark | shift + tap: excl
SIMPLE_MORPH(qexcl, SFT, &kp NO_QMARK, &kp NO_EXCL)

// tap: left/right parenthesis | shft + tap: less-than/greater-than
SIMPLE_MORPH(lpar_lt, SFT, &kp NO_LPAR, &kp LT)
SIMPLE_MORPH(rpar_gt, SFT, &kp NO_RPAR, &kp GT)

// tap: space | shift + tap: dot -> space -> sticky shift | hold: activate layer
ZMK_HOLD_TAP(lt_spc,
    flavor = "balanced";
    tapping-term-ms = <200>;
    quick-tap-ms = <QUICK_TAP_MS>;
    bindings = <&mo>, <&spc_morph>;
)
SIMPLE_MORPH(spc_morph, SFT, &kp SPACE, &dot_spc)
ZMK_MACRO(dot_spc,
    wait-ms = <0>;
    tap-ms = <5>;
    bindings = <&kp DOT &kp SPACE &sk LSHFT>;
)

// tap: backspace | lshft + tap: delete | rshft + tap: shift-delete
ZMK_MOD_MORPH(bs_del,
    bindings = <&kp BSPC>, <&kp DEL>;
    mods = <(MOD_LSFT|MOD_RSFT)>;
    keep-mods = <MOD_RSFT>;
)

// tap: copy | double-tap: cut
ZMK_TAP_DANCE(copy_cut,
    tapping-term-ms = <200>;
    bindings = <&kp LC(INS)>, <&kp LC(X)>;
)

// Windows sleep key
ZMK_MACRO(win_sleep,
    wait-ms = <500>;
    tap-ms = <50>;
    bindings = <&kp LG(X) &kp U &kp S>;
)

// Sticky shift + leader
ZMK_MACRO(leader_sft, bindings = <&sk LSHFT &leader>;)

// misc aliases
#define CANCEL      &kp K_CANCEL             // cancel caps-word, num-word and smart-mouse
#define DSK_PREV    &hmr LCTRL LG(LC(LEFT))  // previous desktop
#define DSK_NEXT    &hmr LALT LG(LC(RIGHT))  // next     desktop
#define PIN_WIN     &kp LG(LC(LS(Q)))        // pin window across desktops
#define PIN_APP     &kp LG(LC(LS(A)))        // pin application across desktops
#define DSK_MGR     &kp LA(GRAVE)            // desktop manager
#define VOL_DOWN    &hmr RSHFT C_VOL_DN

/* Keymap */

ZMK_CONDITIONAL_LAYER(sys, FN NUM, SYS)  // FN + NUM --> SYS

ZMK_LAYER(base,
//╭─────────────┬─────────────┬─────────────┬─────────────┬─────────────╮  ╭─────────────┬─────────────┬─────────────┬─────────────┬─────────────╮ 
    &kp Q         &kp W         &kp E         &kp R         &kp T            &kp Y         &kp U         &kp I         &kp O         &kp P
//├─────────────┼─────────────┼─────────────┼─────────────┼─────────────┤  ├─────────────┼─────────────┼─────────────┼─────────────┼─────────────┤ 
    &hml LGUI A   &hml LALT S   &hml LSHFT D  &hml LCTRL F  &kp G            &kp H         &hmr LCTRL J  &hmr RSHFT K  &hmr LALT L   &hmr LGUI NO_QUOT 
//├─────────────┼─────────────┼─────────────┼─────────────┼─────────────┤  ├─────────────┼─────────────┼─────────────┼─────────────┼─────────────┤ 
    &kp Z         &kp X         &kp C         &kp V         &kp B            &kp N         &kp M         &comma_morph  &dot_morph    &qexcl        
//╰─────────────┴─────────────┴─────────────┼─────────────┼─────────────┤  ├─────────────┼─────────────┼─────────────┴───────────────────────────╯ 
                                              &lt_spc NAV 0 &lt FN RET       SMART_NUM     &smart_shft                                             
//                                          ╰─────────────┴─────────────╯  ╰─────────────┴─────────────╯                                           
)

ZMK_LAYER(nav,
//╭─────────────┬─────────────┬─────────────┬─────────────┬─────────────╮  ╭─────────────┬─────────────┬─────────────┬─────────────┬─────────────╮ 
    ___           ___           &kp LS(TAB)   &swapper      ___              &kp PG_UP     NAV_BSPC      &kp PG_DN     NAV_DEL       &kp AA
//├─────────────┼─────────────┼─────────────┼─────────────┼─────────────┤  ├─────────────┼─────────────┼─────────────┼─────────────┼─────────────┤ 
    &sk LGUI      &sk LALT      &sk LSHFT     &sk LCTRL     ___              NAV_LEFT      NAV_DOWN      NAV_UP        NAV_RIGHT     &kp RET       
//├─────────────┼─────────────┼─────────────┼─────────────┼─────────────┤  ├─────────────┼─────────────┼─────────────┼─────────────┼─────────────┤ 
    ___           ___           ___           ___           ___              &kp INS       &kp TAB       ___           &kp AE        &kp OE
//╰─────────────┴─────────────┴─────────────┼─────────────┼─────────────┤  ├─────────────┼─────────────┼─────────────┴─────────────┼─────────────╯ 
                                              ___           ___              ___           CANCEL                                                  
//                                          ╰─────────────┴─────────────╯  ╰─────────────┴─────────────╯                                           
)

ZMK_LAYER(fn,
//╭─────────────┬─────────────┬─────────────┬─────────────┬─────────────╮  ╭─────────────┬─────────────┬─────────────┬─────────────┬─────────────╮ 
    &kp F12       &kp F7        &kp F8        &kp F9        ___              ___           &kp C_PREV    &kp C_VOL_UP  &kp C_NEXT    &win_sleep    
//├─────────────┼─────────────┼─────────────┼─────────────┼─────────────┤  ├─────────────┼─────────────┼─────────────┼─────────────┼─────────────┤ 
    &hml LGUI F11 &hml LALT F4  &hml LSHFT F5 &hml LCTRL F6 ___              ___           DSK_PREV      VOL_DOWN      DSK_NEXT      ___           
//├─────────────┼─────────────┼─────────────┼─────────────┼─────────────┤  ├─────────────┼─────────────┼─────────────┼─────────────┼─────────────┤ 
    &kp F10       &kp F1        &kp F2        &kp F3        ___              PIN_APP       PIN_WIN       DSK_MGR       ___           ___           
//╰─────────────┴─────────────┴─────────────┼─────────────┼─────────────┤  ├─────────────┼─────────────┼─────────────┴───────────────────────────╯ 
                                              ___           ___              &kp C_MUTE    &kp C_PP                                                
//                                          ╰─────────────┴─────────────╯  ╰─────────────┴─────────────╯                                           
)

ZMK_LAYER(num,
//╭─────────────┬─────────────┬─────────────┬─────────────┬─────────────╮  ╭─────────────┬─────────────┬─────────────┬─────────────┬─────────────╮ 
    ___           &kp N7        &kp N8        &kp N9        ___              ___           &kp N7        &kp N8        &kp N9        ___
//├─────────────┼─────────────┼─────────────┼─────────────┼─────────────┤  ├─────────────┼─────────────┼─────────────┼─────────────┼─────────────┤ 
    &hml LGUI N0  &hml LALT N4  &hml LSHFT N5 &hml LCTRL N6 ___              &hml LCTRL N0 &hml LSHFT N4 &hml RSHFT N5 &hml LALT N6  ___
//├─────────────┼─────────────┼─────────────┼─────────────┼─────────────┤  ├─────────────┼─────────────┼─────────────┼─────────────┼─────────────┤ 
    ___           &kp N1        &kp N2        &kp N3        ___              ___           &kp N1        &kp N2        &kp N3        ___
//╰─────────────┴─────────────┴─────────────┼─────────────┼─────────────┤  ├─────────────┼─────────────┼─────────────┴───────────────────────────╯ 
                                              ___           ___              ___           ___                                                     
//                                          ╰─────────────┴─────────────╯  ╰─────────────┴─────────────╯                                           
)

ZMK_LAYER(sys,
//╭─────────────┬─────────────┬─────────────┬─────────────┬─────────────╮  ╭─────────────┬─────────────┬─────────────┬─────────────┬─────────────╮ 
                               _BT_SEL_KEYS_                                 ___           ___           ___           ___           ___           
//├─────────────┼─────────────┼─────────────┼─────────────┼─────────────┤  ├─────────────┼─────────────┼─────────────┼─────────────┼─────────────┤ 
    ___           ___           ___           ___           &bootloader      &bootloader   ___           ___           ___           ___           
//├─────────────┼─────────────┼─────────────┼─────────────┼─────────────┤  ├─────────────┼─────────────┼─────────────┼─────────────┼─────────────┤ 
    ___           ___           ___           ___           &sys_reset       &sys_reset    ___           ___           ___           ___           
//╰─────────────┴─────────────┴─────────────┼─────────────┼─────────────┤  ├─────────────┼─────────────┼─────────────┴───────────────────────────╯ 
                                              ___           ___              ___           ___                                                     
//                                          ╰─────────────┴─────────────╯  ╰─────────────┴─────────────╯                                           
)

ZMK_LAYER(mouse,
//╭─────────────┬─────────────┬─────────────┬─────────────┬─────────────╮  ╭─────────────┬─────────────┬─────────────┬─────────────┬─────────────╮ 
    ___           ___           ___           ___           ___              U_WH_L        U_WH_D        U_MS_U         U_WH_U       U_WH_R        
//├─────────────┼─────────────┼─────────────┼─────────────┼─────────────┤  ├─────────────┼─────────────┼─────────────┼─────────────┼─────────────┤ 
    ___           ___           ___           ___           ___              ___           U_MS_L        U_MS_D         U_MS_R       ___           
//├─────────────┼─────────────┼─────────────┼─────────────┼─────────────┤  ├─────────────┼─────────────┼─────────────┼─────────────┼─────────────┤ 
    ___           ___           ___           ___           ___              ___           &mkp MB4      &mkp MCLK      &mkp MB5     ___           
//╰─────────────┴─────────────┴─────────────┼─────────────┼─────────────┤  ├─────────────┼─────────────┼─────────────┴───────────────────────────╯ 
                                              ___           ___              &mkp LCLK     &mkp RCLK                                               
//                                          ╰─────────────┴─────────────╯  ╰─────────────┴─────────────╯                                           
)

ZMK_LAYER(game,
//╭─────────────┬─────────────┬─────────────┬─────────────┬─────────────╮  ╭─────────────┬─────────────┬─────────────┬─────────────┬─────────────╮ 
    &mt TAB ESC   &kp Q         &kp W         &kp E         &kp R            &kp NO_PIPE   &kp N7        &kp N8         &kp N9       &kp T
//├─────────────┼─────────────┼─────────────┼─────────────┼─────────────┤  ├─────────────┼─────────────┼─────────────┼─────────────┼─────────────┤ 
    &kp LSFT      &kp A         &kp S         &kp D         &mt N8 N7        &kp N0        &kp N4        &kp N5         &kp N6       &kp V           
//├─────────────┼─────────────┼─────────────┼─────────────┼─────────────┤  ├─────────────┼─────────────┼─────────────┼─────────────┼─────────────┤ 
    &kp LCTRL     &kp N1        &kp N2        &kp N3        &kp N5           &kp C         &kp N1        &kp N2         &kp N3       &kp ENTER           
//╰─────────────┴─────────────┴─────────────┼─────────────┼─────────────┤  ├─────────────┼─────────────┼─────────────┴───────────────────────────╯ 
                                              &mo GAME2     &kp SPC          &kp SPC       &to 0                                               
//                                          ╰─────────────┴─────────────╯  ╰─────────────┴─────────────╯                                           
)

ZMK_LAYER(game2,
//╭─────────────┬─────────────┬─────────────┬─────────────┬─────────────╮  ╭─────────────┬─────────────┬─────────────┬─────────────┬─────────────╮ 
    &kp NO_PIPE   &kp Q         &kp W         &kp F         &kp G            &kp LNLCK     &kp N7        &kp N8         &kp N9       &kp NO_DASH        
//├─────────────┼─────────────┼─────────────┼─────────────┼─────────────┤  ├─────────────┼─────────────┼─────────────┼─────────────┼─────────────┤ 
    &kp CLCK      &kp A         &kp S         &kp D         &kp N6           &kp DOT       &kp N4        &kp N5         &kp N6       &kp NO_PLUS           
//├─────────────┼─────────────┼─────────────┼─────────────┼─────────────┤  ├─────────────┼─────────────┼─────────────┼─────────────┼─────────────┤ 
    &kp LCTRL     &kp Y         &kp U         &kp N0        &kp B            &kp N0        &kp N1        &kp N2         &kp N3       &kp ENTER           
//╰─────────────┴─────────────┴─────────────┼─────────────┼─────────────┤  ├─────────────┼─────────────┼─────────────┴───────────────────────────╯ 
                                              &mo GAME2     &kp SPC          &kp LALT      &to 0                                               
//                                          ╰─────────────┴─────────────╯  ╰─────────────┴─────────────╯                                           
)

/* vim: set ft=c tw=174: */
